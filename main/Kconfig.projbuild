## main/Kconfig.projbuild
```kconfig
menu "Configuração do Wifi Configuration"

    config ESP_WIFI_SSID
        string "WiFi SSID"
        default "ssid"
        help
            Nome da rede Wifi.

    config ESP_WIFI_PASSWORD
        string "Senha do Wifi"
        default "minha_senha"
        help
            Senha do WiFi (WPA or WPA2).

endmenu

menu "Configuração da chave do ipstack"
    config ESP_IPSTACK_KEY
        string "Chave ipstack"
        default "key"
        help
            Chave fornecida pelo site.

endmenu

menu "Configuração da chave do openweather"
    config ESP_OPENWEATHER_KEY
        string "Chave openweather"
        default "key"
        help
            Chave fornecida pelo site.

endmenu
```
